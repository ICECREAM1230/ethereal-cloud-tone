## debug/fdc2214_esp32s3/main/Kconfig.projbuild
```kconfig
menu "FDC2214 standalone raw debug"
config FDC_WIRING_CONFIRMED
    bool "I have confirmed 3.3 V logic, pull-ups, wiring and bus ownership"
    default n
    help
        Leave disabled until the user supplies the actual wiring. Disabled means
        no FDC GPIO or I2C initialization and no peripheral transactions.
config FDC_SDA_GPIO
    int "SDA GPIO (-1 means unassigned)"
    range -1 48
    default -1
config FDC_SCL_GPIO
    int "SCL GPIO (-1 means unassigned)"
    range -1 48
    default -1
config FDC_SD_GPIO
    int "Optional SD output GPIO (-1 means externally held low)"
    range -1 48
    default -1
config FDC_ADDR_GPIO
    int "Optional ADDR output GPIO (-1 means externally strapped)"
    range -1 48
    default -1
config FDC_I2C_ADDRESS
    hex "7-bit I2C address (0x2A low ADDR, 0x2B high ADDR)"
    range 0x2A 0x2B
    default 0x2A
config FDC_I2C_HZ
    int "I2C frequency (Hz)"
    range 10000 400000
    default 100000
choice FDC_CLOCK_SOURCE
    prompt "Confirmed FDC reference clock source"
    default FDC_CLOCK_UNCONFIRMED
config FDC_CLOCK_UNCONFIRMED
    bool "Unconfirmed: no peripheral initialization"
config FDC_CLOCK_EXTERNAL
    bool "External CLKIN (must be supplied by the module/clock source)"
config FDC_CLOCK_INTERNAL
    bool "Internal oscillator (CLKIN wiring must match the datasheet)"
endchoice
config FDC_EXTERNAL_CLOCK_HZ
    int "External clock frequency (Hz, external source only)"
    range 2000000 40000000
    default 40000000
config FDC_EXTERNAL_FREF_DIVIDER
    int "External source FREF divider"
    range 1 1023
    default 1
config FDC_INTERNAL_FREF_DIVIDER
    int "Internal source FREF divider (55 MHz worst case / divider <= 40 MHz)"
    range 2 1023
    default 2
config FDC_RCOUNT
    hex "RCOUNT for all four channels"
    range 0x0009 0xFFFF
    default 0x1000
config FDC_SETTLECOUNT
    hex "SETTLECOUNT for all four channels"
    range 0x0004 0xFFFF
    default 0x0100
config FDC_IDRIVE_CH0
    int "CH0 IDRIVE (initial value only; tune for the actual LC circuit)"
    range 0 31
    default 15
config FDC_IDRIVE_CH1
    int "CH1 IDRIVE"
    range 0 31
    default 15
config FDC_IDRIVE_CH2
    int "CH2 IDRIVE"
    range 0 31
    default 15
config FDC_IDRIVE_CH3
    int "CH3 IDRIVE"
    range 0 31
    default 15
config FDC_TRANSACTION_TIMEOUT_MS
    int "Per I2C transaction timeout (ms)"
    range 10 1000
    default 50
config FDC_DATA_TIMEOUT_MS
    int "No complete four-channel frame timeout (ms)"
    range 100 10000
    default 500
config FDC_OUTPUT_INTERVAL_MS
    int "Minimum interval between CSV sample output (ms)"
    range 50 5000
    default 100
endmenu

menu "FDC volume calibration and I2S test"
config FDC_AUDIO_ENABLE
    bool "Build volume calibration console and four-signal I2S test output"
    default n
    help
        Standalone 440 Hz test tone, not the FPGA/AE350 production synthesizer.
        Output starts silent. External standard I2S DAC/amplifier required.
config FDC_AUDIO_MCLK_GPIO
    int "MCLK GPIO (-1 omits MCLK for DACs that do not need it)"
    range -1 48
    default 15
    depends on FDC_AUDIO_ENABLE
config FDC_AUDIO_BCLK_GPIO
    int "BCLK GPIO"
    range 1 48
    default 5
    depends on FDC_AUDIO_ENABLE
config FDC_AUDIO_WS_GPIO
    int "LRCLK/WS GPIO"
    range 1 48
    default 6
    depends on FDC_AUDIO_ENABLE
config FDC_AUDIO_DOUT_GPIO
    int "DOUT GPIO (connect to DAC DIN)"
    range 1 48
    default 7
    depends on FDC_AUDIO_ENABLE
endmenu
```

## debug/fdc2214_esp32s3/sdkconfig.defaults
```kconfig
CONFIG_IDF_TARGET="esp32s3"
CONFIG_ESPTOOLPY_FLASHMODE_DIO=y
CONFIG_ESPTOOLPY_FLASHFREQ_80M=y
CONFIG_ESPTOOLPY_FLASHSIZE_8MB=y
CONFIG_PARTITION_TABLE_CUSTOM=y
CONFIG_PARTITION_TABLE_CUSTOM_FILENAME="partitions.csv"
CONFIG_FREERTOS_HZ=1000
CONFIG_ESP_CONSOLE_SECONDARY_NONE=y
CONFIG_LOG_DEFAULT_LEVEL_WARN=y
CONFIG_SPIRAM=n
CONFIG_COMPILER_OPTIMIZATION_SIZE=y
```

## esp32/a_board/main/Kconfig.projbuild
```kconfig
menu "Ethereal Cloud Tone test"

config ECT_STRESS_TEST
    bool "Enable synthetic MIDI stress-test injector"
    default n
    help
        Spawns a task at boot that floods the event bus with CC sweeps
        (voice mode / volume / mix) and note on/off for ~60 s, to
        reproduce load-related crashes (issue #70) deterministically
        without an external MIDI source. Leave OFF for normal firmware.

endmenu

menu "FPGA validation image"
config FPGA_AE350_CONTROL
    bool "AE350 CPU1 raw MIDI and template controller"
    depends on IDF_TARGET_ESP32S3 && !FPGA_FM_ONLY
    default y
    help
        This isolated candidate requires MID1 caps bit 2, CPU1 magic and ABI 1.
        Unknown identity or read errors block every write; no legacy fallback.
        Retains the existing SPI pins, Web/BLE RAW queues and template banks.

config FPGA_FM_ONLY
    bool "Use the independent FM-only FPGA validation image"
    depends on IDF_TARGET_ESP32S3
    default n
    help
        Requires FMV1 validation identity and ABI 1.0 at 0x07f0/0x07f1.
        Retains real FM capability/profile verification, raw MIDI and template
        acknowledgements; omits DDS/KS transactions absent from that image.
        The normal controller configuration must leave this disabled.
endmenu

menu "FPGA local web control"
config ECT_WIFI_WEB
    bool "Enable local Wi-Fi SoftAP web controller"
    default n
    help
        Built-in phone controller at http://192.168.4.1. Uses semantic
        events and keyboard leases; BLE MIDI remains available.
if ECT_WIFI_WEB
config ECT_WIFI_SSID
    string "Wi-Fi hotspot SSID (1..32 bytes)"
    default "FPGA_Project"
config ECT_WIFI_PASSWORD
    string "WPA2 password (8..63 ASCII characters; empty uses a stored random password)"
    default "Fpga-Synth-2026"
    help
        Empty generates a 96-bit random password once, persists it in NVS,
        and prints it on the USB serial console. A fixed password is embedded in
        the firmware; do not store private external Wi-Fi credentials here.
config ECT_WIFI_CHANNEL
    int "SoftAP channel"
    range 1 11
    default 6
endif
endmenu
```

## esp32/b_board/main/Kconfig.projbuild
```kconfig
menu "Laser Harp B board"
config B_A_BOARD_BLE_NAME
    string "A board advertised BLE name"
    default "FPGA_Bluetooth"
config B_MIDI_CHANNEL
    int "Synth engine MIDI channel (1-16; wire ID is channel - 1)"
    range 1 16
    default 2
    help
        All twelve beams and encoder controllers share this MIDI channel.
        The receiver selects the synthesis engine by MIDI channel; beam
        identity is carried by note number. The laser harp defaults to
        channel 2, which encodes wire channel ID 1 (in the range 0-15).
        USB and BLE preserve the same channel. Saved NVS settings take
        precedence over this build default.
config B_FIRST_NOTE
    int "First laser MIDI note (C4=60)"
    range 24 92
    default 60
config B_VELOCITY_MIN
    int "Note velocity at short shade (curve start)"
    range 1 127
    default 127
config B_VELOCITY_MAX
    int "Note velocity at long shade (curve end, may be lower)"
    range 1 127
    default 16
config B_DURATION_MIN_MS
    int "Shortest mapped shade duration (ms)"
    range 1 59999
    default 20
config B_DURATION_MAX_MS
    int "Longest mapped shade duration (ms)"
    range 2 60000
    default 500
config B_NOTE_GATE_MS
    int "Sound duration after beam release (ms)"
    range 10 5000
    default 200
config B_LASER_ACTIVE_LEVEL
    int "GPIO level when beam is interrupted (0 or 1)"
    range 0 1
    default 1
choice B_ENCODER_DETENT
    prompt "EC11 transitions per detent"
    default B_ENCODER_HALF_STEP
config B_ENCODER_HALF_STEP
    bool "2 (15 pulses / 30 detents)"
config B_ENCODER_FULL_STEP
    bool "4 (one electrical cycle per detent)"
endchoice
config B_ENCODER_EDGES
    int
    default 2 if B_ENCODER_HALF_STEP
    default 4
config B_ENCODER_REVERSE_MASK
    int "Reverse encoder direction, bit 0..3"
    range 0 15
    default 0
config B_OUTPUT_MODE
    int "Output mode (0=auto,1=USB,2=BLE,3=both)"
    range 0 3
    default 0
config B_ENC1_A
    int "Encoder 1 A GPIO (-1 means unconfigured)"
    range -1 48
    default 13
config B_ENC1_B
    int "Encoder 1 B GPIO (-1 means unconfigured)"
    range -1 48
    default 14
config B_ENC1_SW
    int "Encoder 1 SW GPIO (-1 means unconfigured)"
    range -1 48
    default 12
config B_ENC2_A
    int "Encoder 2 A GPIO (-1 means unconfigured)"
    range -1 48
    default 40
config B_ENC2_B
    int "Encoder 2 B GPIO (-1 means unconfigured)"
    range -1 48
    default 39
config B_ENC2_SW
    int "Encoder 2 SW GPIO (-1 means unconfigured)"
    range -1 48
    default 41
config B_ENC3_A
    int "Encoder 3 A GPIO (-1 means unconfigured)"
    range -1 48
    default 47
config B_ENC3_B
    int "Encoder 3 B GPIO (-1 means unconfigured)"
    range -1 48
    default 21
config B_ENC3_SW
    int "Encoder 3 SW GPIO (-1 means unconfigured)"
    range -1 48
    default 38
config B_ENC4_A
    int "Encoder 4 A GPIO (-1 means unconfigured)"
    range -1 48
    default 2
config B_ENC4_B
    int "Encoder 4 B GPIO (-1 means unconfigured)"
    range -1 48
    default 42
config B_ENC4_SW
    int "Encoder 4 SW GPIO (-1 means unconfigured)"
    range -1 48
    default 1
endmenu
```

## esp32/b_board/sdkconfig.defaults
```kconfig
CONFIG_IDF_TARGET="esp32s3"
CONFIG_B_MIDI_CHANNEL=2
CONFIG_B_DURATION_MIN_MS=20
CONFIG_B_DURATION_MAX_MS=500
CONFIG_B_VELOCITY_MIN=127
CONFIG_B_VELOCITY_MAX=16
CONFIG_B_LASER_ACTIVE_LEVEL=1
CONFIG_ESPTOOLPY_FLASHSIZE_16MB=y
CONFIG_ESPTOOLPY_FLASHMODE_DIO=y
CONFIG_SPIRAM=n
CONFIG_PARTITION_TABLE_CUSTOM=y
CONFIG_PARTITION_TABLE_CUSTOM_FILENAME="partitions.csv"
CONFIG_FREERTOS_HZ=1000
CONFIG_ESP_MAIN_TASK_STACK_SIZE=8192
CONFIG_ESP_CONSOLE_UART_DEFAULT=y
CONFIG_ESP_CONSOLE_UART_BAUDRATE=115200
CONFIG_ESP_CONSOLE_USB_SERIAL_JTAG=n
CONFIG_ESP_CONSOLE_SECONDARY_NONE=y
CONFIG_TINYUSB_MIDI_COUNT=1
CONFIG_TINYUSB_CDC_ENABLED=n
CONFIG_TINYUSB_MSC_ENABLED=n
CONFIG_BT_ENABLED=y
CONFIG_BT_NIMBLE_ENABLED=y
CONFIG_BT_BLUEDROID_ENABLED=n
CONFIG_BT_NIMBLE_ROLE_CENTRAL=y
CONFIG_BT_NIMBLE_ROLE_OBSERVER=y
CONFIG_BT_NIMBLE_ROLE_PERIPHERAL=n
CONFIG_BT_NIMBLE_ROLE_BROADCASTER=n
CONFIG_BT_NIMBLE_MAX_CONNECTIONS=1
CONFIG_BT_NIMBLE_SECURITY_ENABLE=y
CONFIG_BT_NIMBLE_NVS_PERSIST=n
CONFIG_LOG_DEFAULT_LEVEL_INFO=y
CONFIG_B_ENC1_A=13
CONFIG_B_ENC1_B=14
CONFIG_B_ENC1_SW=12
CONFIG_B_ENC2_A=40
CONFIG_B_ENC2_B=39
CONFIG_B_ENC2_SW=41
CONFIG_B_ENC3_A=47
CONFIG_B_ENC3_B=21
CONFIG_B_ENC3_SW=38
CONFIG_B_ENC4_A=2
CONFIG_B_ENC4_B=42
CONFIG_B_ENC4_SW=1
```
